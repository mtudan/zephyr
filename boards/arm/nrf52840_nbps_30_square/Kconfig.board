## boards/arm/nrf52840_nbps_30_square/Kconfig.board
```kconfig
# NBPS_30_SQUARE board configuration

# Copyright (c) 2020 Mobilisis d.o.o.
# SPDX-License-Identifier: Apache-2.0

config BOARD_NRF52840_NBPS_30_SQUARE
	bool "NBPS_30_SQUARE"
	depends on SOC_NRF52840_QIAA
```

## boards/arm/nrf52840_nbps_30_square/Kconfig.defconfig
```kconfig
# NRF52840_NBPS_30_SQUARE board configuration

# Copyright (c) 2020 Mobilisis d.o.o.
# SPDX-License-Identifier: Apache-2.0

if BOARD_NRF52840_NBPS_30_SQUARE

config BOARD
	default "NRF52840_NBPS_30_SQUARE"

if USB

config USB_NRFX
	default y

config USB_DEVICE_STACK
	default y

endif # USB

config IEEE802154_NRF5
	default y
	depends on IEEE802154

config BT_CTLR
	default BT

endif # BOARD_NRF52840_NBPS_30_SQUARE
```

## drivers/counter/Kconfig.renesas_isl12057
```kconfig
# Copyright (c) 2021 Matija Tudan
#
# SPDX-License-Identifier: Apache-2.0
#

config COUNTER_RENESAS_ISL12057
	bool "Renesas ISL12057 RTC"
	depends on I2C
	help
	  Enable counter driver based on Renesas ISL12057 I2C device.

config COUNTER_RENESAS_ISL12057_INIT_PRIORITY
	int "Init priority"
	depends on COUNTER_RENESAS_ISL12057
	default 65
	help
	  ISL12057 device driver initialization priority.
```

## dts/bindings/adc/ti,ads1015.yaml
```yaml
# Copyright (c) 2021 Matija Tudan
# SPDX-License-Identifier: Apache-2.0

description: TI ADS1015

compatible: "ti,ads1015"

include: ti,ads101x-base.yaml
```

## dts/bindings/adc/ti,ads101x-base.yaml
```yaml
# Copyright (c) 2021 Matija Tudan
# SPDX-License-Identifier: Apache-2.0

include: [adc-controller.yaml, i2c-device.yaml]

properties:
    "#io-channel-cells":
      const: 1

io-channel-cells:
    - channel
```
